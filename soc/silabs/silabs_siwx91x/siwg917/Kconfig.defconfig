## soc/silabs/silabs_siwx91x/siwg917/Kconfig.defconfig
```kconfig
# Copyright (c) 2024 Silicon Laboratories Inc.
# SPDX-License-Identifier: Apache-2.0

if SOC_SERIES_SIWG917

config NUM_IRQS
	default 99

config SOC_PREP_HOOK
	def_bool y
	help
	  Enable soc_prep_hook() to copy .rodata from flash to RAM before
	  soc_early_init_hook() is called.

endif
```
